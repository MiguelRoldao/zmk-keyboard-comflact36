## boards/shields/comflact36/Kconfig.shield
```kconfig
# No whitespace after the comma or in your keyboard name!
config SHIELD_COMFLACT36
    def_bool $(shields_list_contains,comflact36)
```

## west.yml
```yaml
manifest:
  remotes:
    - name: zmkfirmware
      url-base: https://github.com/zmkfirmware
    - name: miguelroldao
      url-base: https://github.com/miguelroldao
  projects:
    # Together with the above defined remote, this refers to a module located at
    # https://github.com/remote-name/repository-name
    - name: repository-name
      remote: remote-name
      # This points to a west manifest file in the remote module for further imports
      import: west.yml
```
